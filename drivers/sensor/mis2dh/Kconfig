## drivers/sensor/mis2dh/Kconfig
```kconfig
# ST Microelectronics MIS2DH 3-axis accelerometer driver

# Copyright (c) 2021 SKA Polska
# SPDX-License-Identifier: Apache-2.0

menuconfig MIS2DH
	bool "MIS2DH I2C/SPI accelerometer sensor driver"
	depends on I2C || SPI
	help
	  Enable driver for MIS2DH accelerometer sensor driver

if MIS2DH

choice MIS2DH_TRIGGER_MODE
	prompt "Trigger mode"
	help
	  Specify the type of triggering to be used by the driver.

config MIS2DH_TRIGGER_NONE
	bool "No trigger"

config MIS2DH_TRIGGER_GLOBAL_THREAD
	bool "Use global thread"
	depends on GPIO
	select MIS2DH_TRIGGER

config MIS2DH_TRIGGER_OWN_THREAD
	bool "Use own thread"
	depends on GPIO
	select MIS2DH_TRIGGER

endchoice

config MIS2DH_TRIGGER
	bool

config MIS2DH_THREAD_PRIORITY
	int "Thread priority"
	depends on MIS2DH_TRIGGER_OWN_THREAD
	default 10
	help
	  Priority of thread used by the driver to handle interrupts.

config MIS2DH_THREAD_STACK_SIZE
	int "Thread stack size"
	depends on MIS2DH_TRIGGER_OWN_THREAD
	default 1024
	help
	  Stack size of thread used by the driver to handle interrupts.

config MIS2DH_ENABLE_TEMP
	bool "Enable temperature sensor"
	help
	  Enable/disable temperature sensor

menu "Attributes"

config MIS2DH_FS
	int "Accelerometer full-scale range"
	default 0
	help
	  Specify the default accelerometer full-scale range.
	  An X value for the config represents a range of +/- X G. Valid values
	  are:
	  0:  Full Scale selected at runtime
	  2:  +/- 2g
	  4:  +/- 4g
	  8:  +/- 8g
	  16: +/- 16g

config MIS2DH_ODR
	int "Accelerometer Output data rate frequency"
	range 0 10
	default 0
	help
	  Specify the default accelerometer output data rate expressed in
	  samples per second (Hz).
	  0: ODR selected at runtime
	  1: 1Hz
	  2: 10Hz
	  3: 25Hz
	  4: 50Hz
	  5: 100Hz
	  6: 200Hz
	  7: 400Hz
endmenu

endif # MIS2DH
```
